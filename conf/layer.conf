## conf/layer.conf
```bitbake
#
# SPDX-License-Identifier: MIT
#

# We have a conf and classes directory, add to BBPATH
BBPATH .= ":${LAYERDIR}"
BBPATH .= ":${LAYERDIR}/dynamic-layers/meta-ewaol"

addpylib ${LAYERDIR}/lib oeqa

BBFILES += "${LAYERDIR}/recipes-*/*/*.bb \
            ${LAYERDIR}/recipes-*/*/*.bbappend"

BBFILES_DYNAMIC += "\
    meta-ewaol:${LAYERDIR}/dynamic-layers/meta-ewaol/recipes-*/*/*.bb \
    meta-ewaol:${LAYERDIR}/dynamic-layers/meta-ewaol/recipes-*/*/*.bbappend \
    meta-cassini-tests:${LAYERDIR}/dynamic-layers/meta-cassini/meta-cassini-tests/recipes-*/*/*.bb \
    meta-cassini-tests:${LAYERDIR}/dynamic-layers/meta-cassini/meta-cassini-tests/recipes-*/*/*.bbappend \
    meta-python:${LAYERDIR}/dynamic-layers/meta-openembedded/meta-python/recipes-*/*/*.bb \
    meta-python:${LAYERDIR}/dynamic-layers/meta-openembedded/meta-python/recipes-*/*/*.bbappend \
    integrity-layer:${LAYERDIR}/dynamic-layers/meta-secure-core/meta-integrity/recipes-*/*/*.bb \
    integrity-layer:${LAYERDIR}/dynamic-layers/meta-secure-core/meta-integrity/recipes-*/*/*.bbappend \
    virtualization-layer:${LAYERDIR}/dynamic-layers/meta-virtualization/recipes-*/*/*.bb \
    virtualization-layer:${LAYERDIR}/dynamic-layers/meta-virtualization/recipes-*/*/*.bbappend \
"

# Register this layer collection
BBFILE_COLLECTIONS += "meta-hsoc-auto-solutions"
BBFILE_PATTERN_meta-hsoc-auto-solutions = "^${LAYERDIR}/"
BBFILE_PRIORITY_meta-hsoc-auto-solutions = "12"

LAYERDEPENDS_meta-hsoc-auto-solutions = "\
    core \
    meta-arm-auto-solutions \
"
LAYERSERIES_COMPAT_meta-hsoc-auto-solutions = "walnascar"

HSOC_APOLLO_REPO_DIRECTORY = "${LAYERDIR}/../../"

# Keep the Aspen non-OTA image layout independent from meta-cassini's
# kas-time mender-full patch.
INHERIT:remove:cassini = "mender-full"
```

## dynamic-layers/meta-ewaol/conf/distro/include/cloud-services/bluechi.inc
```bitbake
# SPDX-License-Identifier: MIT

# Local replacement for the kas-applied meta-ewaol bluechi.inc patch.

VIRTUAL-RUNTIME_container_engine:${BASE_DISTRO} = "podman"

DISTRO_FEATURES:append:${BASE_DISTRO} = " overlayfs"

OVERLAYFS_MOUNT_POINT[data] = "/var/volatile"
OVERLAYFS_WRITABLE_PATHS[data] = "/var/lib/containers/storage/overlay"
```
