## conf/distro/auto-ad-nexios.conf
```bitbake
# SPDX-License-Identifier: MIT

require conf/distro/cassini.conf

DISTRO = "auto-ad-nexios"
DISTRO_NAME = "Auto AD Nexios"

# Auto AD Nexios requires the PREEMPT_RT kernel profile.
PREFERRED_PROVIDER_virtual/kernel = "linux-yocto-rt"

# Auto AD Nexios is based on Cassini and keeps EWAOL image-feature
# compatibility for the Arm Auto Solutions baremetal image flow.
BASE_DISTRO = "cassini"
DISTROOVERRIDES .= ":ewaol:${BASE_DISTRO}"

CASSINI_ADMIN_ACCOUNT = "ewaol"
DISTRO_FEATURES:append = " ewaol-cloud"
DISTRO_FEATURES:append:auto-ad-nexios = " security integrity overlayfs"

APOLLO_DM_VERITY ?= "1"
APOLLO_BSP_BUILD_ONLY ?= "0"
SI_CL1_CPUS_COUNT ?= "4"

require ${@'conf/distro/include/auto-ad-nexios-dm-verity.inc' if d.getVar('APOLLO_DM_VERITY') == '1' and d.getVar('APOLLO_BSP_BUILD_ONLY') != '1' else ''}

OVERLAYFS_ETC_MOUNT_POINT:auto-ad-nexios = "/rootrw"
OVERLAYFS_ETC_FSTYPE:auto-ad-nexios = "ext4"
OVERLAYFS_ETC_DEVICE:auto-ad-nexios = "LABEL=rootrw"
OVERLAYFS_ETC_MOUNT_OPTIONS:auto-ad-nexios = "defaults"
OVERLAYFS_ETC_CREATE_MOUNT_DIRS:auto-ad-nexios = "0"

USER_CLASSES:append = " ewaol-features"
VIRTUAL-RUNTIME_ota_update = "no-ota"

WKS_FILE:apollo-fvp:auto-ad-nexios = "${@bb.utils.contains('APOLLO_DM_VERITY', '1', 'apollo-fvp-auto-ad-nexios-ab.wks.in', 'apollo-fvp-auto-ad-nexios-ab-plain.wks.in', d)}"
WKS_FILE_DEPENDS:append:apollo-fvp:auto-ad-nexios = " auto-ad-nexios-boot-state"
WKS_FILE:apollo-qvp:auto-ad-nexios = "${@bb.utils.contains('APOLLO_DM_VERITY', '1', 'apollo-qvp-auto-ad-nexios-ab.wks.in', 'apollo-qvp-auto-ad-nexios-ab-plain.wks.in', d)}"
WKS_FILE_DEPENDS:append:apollo-qvp:auto-ad-nexios = " auto-ad-nexios-boot-state"

HSOC_APOLLO_FVP_TEST_SUITES = "\
    test_00_fvp_boot \
    test_00_rse_boot \
    test_00_si_cl0_boot \
    test_00_si_cl1_boot \
    test_00_tfa_secure_partition_boot \
    test_00_uboot_boot \
    test_00_systemd_boot \
    test_00_linux_boot \
    test_00_safety_boot \
    test_00_apollo_uki_boot \
    test_20_si_cl0_diagnostics \
    test_21_si_cl0_pfdi \
    test_22_si_cl0_smcf \
    test_30_si_cl1_pfdi \
    test_31_si_cl1_hipc \
    test_40_tfa_cpu_topology \
    test_41_tfa_ras \
    test_60_linux_connectivity \
    test_61_linux_dsu \
    test_62_linux_cpu_topology \
    test_63_linux_fvp_devices \
    test_64_linux_pfdi \
    test_65_linux_crypto \
    test_70_power_scmi \
    test_71_power_cpuidle \
    test_72_power_cpufreq \
    test_73_power_mbpp \
    test_80_trusted_services \
    "

TEST_SUITES:apollo-fvp:auto-ad-nexios = "${HSOC_APOLLO_FVP_TEST_SUITES}"
TEST_SUITES:apollo-qvp:auto-ad-nexios = "${HSOC_APOLLO_FVP_TEST_SUITES}"

# Keep the QVP override explicit for a future QBox-specific controller.
TEST_TARGET:apollo-fvp:auto-ad-nexios = "HSOCOEFVPTarget"
TEST_TARGET:apollo-qvp:auto-ad-nexios = "HSOCOEFVPTarget"

TEST_FVP_DEVICES:apollo-fvp:auto-ad-nexios = "rtc watchdog networking virtiorng cpu_hotplug"
TEST_FVP_DEVICES:apollo-qvp:auto-ad-nexios = "rtc watchdog networking virtiorng cpu_hotplug"
TESTIMAGE_UPDATE_VARS:append:apollo-fvp:auto-ad-nexios = " TEST_FVP_DEVICES SI_CL1_CPUS_COUNT"
TESTIMAGE_UPDATE_VARS:append:apollo-qvp:auto-ad-nexios = " TEST_FVP_DEVICES SI_CL1_CPUS_COUNT"

HSOC_RUN_TEST_SKIP_SUITES:apollo-fvp:auto-ad-nexios = "\
    test_00_aspen_boot \
    test_10_pfdi \
    test_10_ras_cpu \
    test_10_sbistc_integration \
    test_20_hipc_baremetal \
    test_50_cryptographic_extension \
    test_99_uefi_secure_boot \
    test_100_fwu \
    "
HSOC_RUN_TEST_SKIP_SUITES:apollo-qvp:auto-ad-nexios = "\
    test_00_aspen_boot \
    test_10_pfdi \
    test_10_ras_cpu \
    test_10_sbistc_integration \
    test_20_hipc_baremetal \
    test_50_cryptographic_extension \
    test_99_uefi_secure_boot \
    test_100_fwu \
    "
HSOC_RUN_TEST_SKIP_EXTRA_LANES:apollo-fvp:auto-ad-nexios = "\
    extra-sw-ref-stack-unittests \
    "
HSOC_RUN_TEST_SKIP_EXTRA_LANES:apollo-qvp:auto-ad-nexios = "\
    extra-sw-ref-stack-unittests \
    "
HSOC_RUN_TEST_SKIP_REASON:apollo-fvp:auto-ad-nexios = "excluded_by_hsoc_yocto_build_config"
HSOC_RUN_TEST_SKIP_REASON:apollo-qvp:auto-ad-nexios = "excluded_by_hsoc_yocto_build_config"
```

## conf/distro/include/auto-ad-nexios-dm-verity.inc
```bitbake
# SPDX-License-Identifier: MIT

IMAGE_CLASSES:append:auto-ad-nexios = " dm-verity-img"
DM_VERITY_IMAGE:auto-ad-nexios = "nexios-image"
DM_VERITY_IMAGE_TYPE:auto-ad-nexios = "ext4"
DM_VERITY_SEPARATE_HASH:auto-ad-nexios = "0"

require conf/distro/include/auto-ad-nexios-initramfs.inc
```

## conf/distro/include/auto-ad-nexios-initramfs.inc
```bitbake
# SPDX-License-Identifier: MIT

INITRAMFS_IMAGE:auto-ad-nexios = "nexios-initramfs-image"
INITRAMFS_FSTYPES:auto-ad-nexios = "cpio.gz"
INITRD_ARCHIVE:auto-ad-nexios = "${INITRAMFS_IMAGE}-${MACHINE}.${INITRAMFS_FSTYPES}"
```
